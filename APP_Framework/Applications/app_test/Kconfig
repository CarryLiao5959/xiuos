## Ubiquitous/RT-Thread_Fusion_XiUOS/aiit_board/xidatong-riscv64/base-drivers/Kconfig
```kconfig
menu "Board Drivers Config"
    
menu "On-chip Peripheral Drivers"
    config __STACKSIZE__
        int "stack size for interrupt"
        default 4096
    config BSP_USING_UART_HS
        bool "Enable High Speed UART"
        default n
    menuconfig BSP_USING_UART1
        bool "Enable UART1"
        default n
        if BSP_USING_UART1
            config BSP_UART1_TXD_PIN
                int "uart1 TXD pin number"
                default 19
            config BSP_UART1_RXD_PIN
                int "uart1 RXD pin number"
                default 18
            config BSP_UART1_RTS_PIN
                int "uart1 RTS pin number (-1 for not used)"
                default -1
            config BSP_UART1_CTS_PIN
                int "uart1 CTS pin number (-1 for not used)"
                default -1            
        endif
    menuconfig BSP_USING_UART2
        bool "Enable UART2"
        default n
        if BSP_USING_UART2
            config BSP_UART2_TXD_PIN
                int "uart2 TXD pin number"
                default 20
            config BSP_UART2_RXD_PIN
                int "uart2 RXD pin number"
                default 21
            config BSP_UART2_RTS_PIN
                int "uart2 RTS pin number (-1 for not used)"
                default -1
            config BSP_UART2_CTS_PIN
                int "uart2 CTS pin number (-1 for not used)"
                default -1               
        endif
    menuconfig BSP_USING_UART3
        bool "Enable UART3"
        default n
        if BSP_USING_UART3
            config BSP_UART3_TXD_PIN
                int "uart3 TXD pin number"
                default 22
            config BSP_UART3_RXD_PIN
                int "uart3 RXD pin number"
                default 23
            config BSP_UART3_RTS_PIN
                int "uart3 RTS pin number (-1 for not used)"
                default -1
            config BSP_UART3_CTS_PIN
                int "uart3 CTS pin number (-1 for not used)"
                default -1               
        endif

    menuconfig BSP_USING_I2C1
        bool "Enable I2C1"
        select RT_USING_I2C
        default n
        if BSP_USING_I2C1
            config BSP_I2C1_SDA_PIN 
                int "I2C1 sda pin number"
                default 15
            config BSP_I2C1_SCL_PIN
                int "I2C1 scl pin number"
                default 17
        endif

    menuconfig BSP_USING_SPI1
        bool "Enable SPI1"
        select RT_USING_SPI
        default n
        if BSP_USING_SPI1
            config BSP_SPI1_CLK_PIN
                int "spi1 clk pin number"
                default 9
            config BSP_SPI1_D0_PIN
                int "spi1 d0 pin number"
                default 11
            config BSP_SPI1_D1_PIN
                int "spi1 d1 pin number"
                default 10
            menuconfig BSP_SPI1_USING_SS0
                bool "SPI1 Enable SS0(spi10 dev)"
                default n
            if BSP_SPI1_USING_SS0
                config BSP_SPI1_SS0_PIN
                    int "spi1 ss0 pin number"
                    default 12
            endif
            menuconfig BSP_SPI1_USING_SS1
                bool "SPI1 Enable SS1(spi11 dev)"
                default n
            if BSP_SPI1_USING_SS1
                config BSP_SPI1_SS1_PIN
                    int "spi1 ss1 pin number"
                    default 8
            endif
            menuconfig BSP_SPI1_USING_SS2
                bool "SPI1 Enable SS2(spi12 dev)"
                default n
            if BSP_SPI1_USING_SS2
                config BSP_SPI1_SS2_PIN
                    int "spi1 ss2 pin number"
                    default 26
            endif
            menuconfig BSP_SPI1_USING_SS3
                bool "SPI1 Enable SS3(spi13 dev)"
                default n
            if BSP_SPI1_USING_SS3
                config BSP_SPI1_SS3_PIN
                    int "spi1 ss3 pin number"
                    default 27
            endif
        endif
    menuconfig BSP_USING_CAN
        bool "Enable CAN"
        select RT_USING_CAN
        select BSP_USING_UART1
        default n 
        if BSP_USING_CAN
            config BSP_CAN_NCFG_PIN
                int "CAN nCFG pin number"
                default 43
        endif        
endmenu

menu "Onboard Peripheral Drivers"
    menuconfig BSP_USING_LCD
    bool "Enable LCD on SPI0"
    default n
    if BSP_USING_LCD
        config BSP_LCD_CS_PIN
            int "CS pin number of 8080 interface"
            default 41
        config BSP_LCD_WR_PIN
            int "WR pin number of 8080 interface"
            default 38
        config BSP_LCD_DC_PIN
            int "DC pin number of 8080 interface"
            default 39
        config BSP_LCD_RST_PIN
            int "RESET pin number of 8080 interface (-1 for not used)"
            default 37
        config BSP_LCD_BACKLIGHT_PIN
            int "Backlight control pin number (-1 for not used)"
            default -1
        choice
            prompt "backlight active polarity"
            default BSP_LCD_BACKLIGHT_ACTIVE_LOW
            
            config BSP_LCD_BACKLIGHT_ACTIVE_LOW
                bool "lcd backlight on low level"
            config BSP_LCD_BACKLIGHT_ACTIVE_HIGH
                bool "lcd_backlight on high level"
        endchoice

        config BSP_LCD_CLK_FREQ
            int "Lcd max clk frequency"
            default 15000000
        
        choice
            prompt "lcd scan direction"
            default BSP_BOARD_KD233

            config  BSP_BOARD_KD233
                bool "board_kd233 lcd scan: DIR_YX_RLUD"

            config  BSP_BOARD_K210_OPENMV_TEST
                bool "board_k210_openmv lcd scan: DIR_YX_LRUD"

            config  BSP_BOARD_USER
                bool "board_user: user defined."    
        endchoice

        config BSP_LCD_X_MAX
            int "LCD Height"
            default 272
        config BSP_LCD_Y_MAX
            int "LCD Width"
            default 480
    endif
    menuconfig BSP_USING_CH438
    bool "Enable CH438"
    default y
        if BSP_USING_CH438
            config CONFIG_CH438_EXTUART0
                bool "Enable CH438_EXTUART0"
                default n
            config CONFIG_CH438_EXTUART1
                bool "Enable CH438_EXTUART1"
                default n
            config CONFIG_CH438_EXTUART2
                bool "Enable CH438_EXTUART2"
                default n
            config CONFIG_CH438_EXTUART3
                bool "Enable CH438_EXTUART3"
                default n
            config CONFIG_CH438_EXTUART4
                bool "Enable CH438_EXTUART4"
                default n
            config CONFIG_CH438_EXTUART5
                bool "Enable CH438_EXTUART5"
                default n
            config CONFIG_CH438_EXTUART6
                bool "Enable CH438_EXTUART6"
                default n
            config CONFIG_CH438_EXTUART7
                bool "Enable CH438_EXTUART7"
                default n
        endif
    menuconfig BSP_USING_CH376
    bool "Enable CH376"
    default n
    select BSP_USING_UART3
    if BSP_USING_CH376
        choice
            prompt "select ch376 function."
            default CH376_USB_FUNCTION
        config CH376_USB_FUNCTION
            bool "select ch376 usb function"
        config CH376_SD_FUNCTION
            bool "select ch376 sd function"
        endchoice
        config CH376_WORK_MODE
            hex "ch376 work mode set:0x03 sd,0x06 u-disk"
            default 0x03 if CH376_SD_FUNCTION
            default 0x06 if CH376_USB_FUNCTION
    endif
endmenu

endmenu
```

## Ubiquitous/XiZi/board/xidatong-riscv64/third_party_driver/Kconfig
```kconfig
menuconfig BSP_USING_DMA
bool "Using DMA device"
default y
if BSP_USING_DMA
source "$BSP_DIR/third_party_driver/dma/Kconfig"
endif

menuconfig BSP_USING_GPIO
bool "Using GPIO device"
default y
select RESOURCES_PIN
if BSP_USING_GPIO
source "$BSP_DIR/third_party_driver/gpio/Kconfig"
endif

menuconfig BSP_USING_I2C
bool "Using I2C device"
default n
select RESOURCES_I2C
if BSP_USING_I2C
source "$BSP_DIR/third_party_driver/i2c/Kconfig"
endif

menuconfig BSP_USING_TOUCH
bool "Using TOUCH device"
default n
select RESOURCES_TOUCH
select BSP_USING_I2C
if BSP_USING_TOUCH
source "$BSP_DIR/third_party_driver/touch/Kconfig"
endif

menuconfig BSP_USING_PLIC
bool "Using PLIC device"
default n
if BSP_USING_PLIC
source "$BSP_DIR/third_party_driver/plic/Kconfig"
endif

menuconfig BSP_USING_SYSCLOCK
bool "Using SYSCLOCK device"
default y
if BSP_USING_SYSCLOCK
source "$BSP_DIR/third_party_driver/sys_clock/Kconfig"
endif

menuconfig BSP_USING_UART
bool "Using UART device"
default y
select RESOURCES_SERIAL
if BSP_USING_UART
source "$BSP_DIR/third_party_driver/uart/Kconfig"
endif
```

## Ubiquitous/XiZi_IIoT/board/hc32f4a0/Kconfig
```kconfig
mainmenu "XiZi_IIoT Project Configuration"

config BSP_DIR
    string
    option env="BSP_ROOT"
    default "."

config KERNEL_DIR
    string
    option env="KERNEL_ROOT"
    default "../.."

config BOARD_HC32F4A0_EVB
    bool
    select ARCH_ARM
    default y

source "$KERNEL_DIR/arch/Kconfig"

menu "hc32f4a0 feature"
    source "$BSP_DIR/third_party_driver/Kconfig"
    
    menu "config default board resources"
        menu "config board app name"
            config BOARD_APP_NAME
                string "config board app name"
                default "/XiUOS_hc32f4a0_app.bin"
        endmenu
    endmenu

endmenu

menu "Hardware feature"
source "$KERNEL_DIR/resources/Kconfig"
endmenu

source "$KERNEL_DIR/Kconfig"
```

## Ubiquitous/XiZi_IIoT/board/hc32f4a0/third_party_driver/Kconfig
```kconfig
menuconfig BSP_USING_UART
    bool "Using UART device"
    default y
    select RESOURCES_SERIAL
    if BSP_USING_UART
        source "$BSP_DIR/third_party_driver/usart/Kconfig"
    endif

menuconfig BSP_USING_GPIO
    bool "Using GPIO device "
    default y
    select RESOURCES_PIN
    if BSP_USING_GPIO
        source "$BSP_DIR/third_party_driver/gpio/Kconfig"
    endif

menuconfig BSP_USING_LWIP
    bool "Using LwIP by ethernet device"
    default n
    select RESOURCES_LWIP
    if BSP_USING_LWIP
        source "$BSP_DIR/third_party_driver/ethernet/Kconfig"
    endif

menuconfig BSP_USING_SPI
    bool "Using SPI device"
    default n
    select RESOURCES_SPI
    if BSP_USING_SPI
        source "$BSP_DIR/third_party_driver/spi/Kconfig"
    endif

menuconfig BSP_USING_I2C
    bool "Using I2C device"
    default n
    select RESOURCES_I2C
    if BSP_USING_I2C
        source "$BSP_DIR/third_party_driver/i2c/Kconfig"
    endif

menuconfig BSP_USING_SDIO
    bool "Using SD CARD device"
    default n
    select RESOURCES_SDIO
    if BSP_USING_SDIO
        source "$BSP_DIR/third_party_driver/sdio/Kconfig"
    endif

menuconfig BSP_USING_USB
    bool "Using USB device"
    default n
    select RESOURCES_USB
    if BSP_USING_USB
        source "$BSP_DIR/third_party_driver/usb/Kconfig"
    endif
```

## Ubiquitous/XiZi_IIoT/board/hc32f4a0/third_party_driver/spi/Kconfig
```kconfig
if BSP_USING_SPI
    config BSP_USING_SPI1
    bool "Using spi1"
    default y

    if BSP_USING_SPI1
        config SPI_BUS_NAME_1
            string "spi bus 1 name"
            default "spi1"
        config SPI_1_DEVICE_NAME_0
            string "spi bus 1 device 0 name"
            default "spi1_dev0" 
        config SPI_1_DRV_NAME
            string "spi bus 1 driver name"
            default "spi1_drv"

        menuconfig RESOURCES_SPI_LORA
            bool "Using spi lora function"
            default n
            if RESOURCES_SPI_LORA
                config SX12XX_DEVICE_NAME
                string "SX12XX(SX1278 SX1276) lora device name"
                default "spi1_lora"
            endif
    endif   

    config BSP_USING_SPI6
    bool "Using spi6"
    default n

    if BSP_USING_SPI6
        config SPI_BUS_NAME_6
            string "spi bus 6 name"
            default "spi6"
        config SPI_6_DEVICE_NAME_0
            string "spi bus 6 device 0 name"
            default "spi6_dev0" 
        config SPI_6_DRV_NAME
            string "spi bus 6 driver name"
            default "spi6_drv"
    endif  
endif
```
