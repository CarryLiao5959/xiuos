## APP_Framework/Applications/app_test/Kconfig
```kconfig
menu "test app"
    menuconfig USER_TEST
        bool "Enable application test function "
        default n

        if USER_TEST
            menuconfig USER_TEST_ADC
                bool "Config test adc"
                default n
                if USER_TEST_ADC
                    if ADD_XIZI_FETURES
                        config ADC_DEV_DRIVER
                            string "Set ADC dev path"
                            default "/dev/adc1_dev"
                    endif
                endif

            menuconfig USER_TEST_DAC
                bool "Config test dac"
                default n
                if USER_TEST_DAC
                    if ADD_XIZI_FETURES
                        config DAC_DEV_DRIVER
                            string "Set DAC dev path"
                            default "/dev/dac_dev"
                    endif
                endif

            menuconfig USER_TEST_FS
                bool "Config test fs with sd or usb"
                default n
                if USER_TEST_FS
                    if ADD_XIZI_FETURES
                        config FPATH
                            string "Set test file path"
                            default "/test_file"
                    endif
                endif


            menuconfig USER_TEST_GPIO
                select BSP_USING_GPIO
                select RESOURCES_PIN
                select BSP_USING_LED
                select BSP_USING_KEY
                bool "Config test gpio with led and key"
                default n
                if USER_TEST_GPIO
                    if ADD_XIZI_FETURES
                        config GPIO_DEV_DRIVER
                            string "Set gpio dev path"
                            default "/dev/pin_dev"
                    endif
                endif

            menuconfig USER_TEST_LORA
                select BSP_USING_UART
                select BSP_USING_GPIO
                select RESOURCES_PIN
                select BSP_USING_UART2
                select BSP_USING_LORA
                bool "Config test uart(loraE220)"
                default n
                if USER_TEST_LORA
                    if ADD_XIZI_FETURES
                        config LORA_UART_DEV_DRIVER
                            string "Set uart dev path"
                            default "/dev/uart2_dev2"
                        config LORA_PIN_DEV_DRIVER
                            string "Set pin dev path"
                            default "/dev/pin_dev"
                    endif
                endif

            menuconfig USER_TEST_RS485
                select BSP_USING_UART
                select BSP_USING_GPIO
                select RESOURCES_PIN
                select BSP_USING_UART1
                bool "Config test uart(RS485)"
                default n
                if USER_TEST_RS485
                    if ADD_XIZI_FETURES
                        config RS485_UART_DEV_DRIVER
                            string "Set uart dev path"
                            default "/dev/uart1_dev1"
                        config RS485_PIN_DEV_DRIVER
                            string "Set pin dev path"
                            default "/dev/pin_dev"
                    endif
                endif

            menuconfig USER_TEST_RTC
                select BSP_USING_RTC
                bool "Config test rtc"
                default n
                if USER_TEST_RTC
                    if ADD_XIZI_FETURES
                        config RTC_DEV_DRIVER
                            string "Set rtc dev path"
                            default "/dev/rtc_dev"
                    endif
                endif

            menuconfig USER_TEST_HWTIMER
                select BSP_USING_HWTIMER
                select BSP_USING_GPIO
                bool "Config test hwtimer"
                default n
                if USER_TEST_HWTIMER
                    if ADD_XIZI_FETURES
                        config HWTIMER_PIN_DEV_DRIVER
                            string "Set pin dev path"
                            default "/dev/pin_dev"
                    endif
                endif

            menuconfig USER_TEST_WDT
                select BSP_USING_WDT0
                bool "Config test watchdog"
                default n
                if USER_TEST_WDT
                    if ADD_XIZI_FETURES
                        config WDT0_DEV_DRIVER
                            string "Set wdt dev path"
                            default "/dev/wdt0_dev0"
                    endif
                endif

            menuconfig USER_TEST_LCD_EDU
                select BSP_USING_LCD
                bool "Config test lcd in PrivOpen"
                default n
                if USER_TEST_LCD_EDU
                    if ADD_XIZI_FETURES
                        config EDU_LCD_DEV_DRIVER
                            string "Set lcd dev path"
                            default "/dev/lcd_dev"
                    endif
                endif

            menuconfig USER_TEST_I2C
                select BSP_USING_I2C
                bool "Config test i2c"
                default n
                if USER_TEST_I2C
                    if ADD_XIZI_FETURES
                        config I2C_DEV_DRIVER
                            string "Set i2c dev path"
                            default "/dev/i2c1_dev0"
                    endif
                endif

            config USER_TEST_SEMC
                bool "Config test semc sdram"
                default n

            config USER_TEST_LCD
                bool "Config test lcd device"
                default n

                
        endif
endmenu
```

## APP_Framework/Framework/connection/lora/e22/Kconfig
```kconfig
config ADAPTER_LORA_E22
        string "E22-400T33D adapter name"
        default "e22"

if ADD_XIZI_FETURES

endif

if ADD_NUTTX_FETURES

    config ADAPTER_E22_M0_PATH
        string "E22 M0 pin device"
        default "/dev/gpio0"

    config ADAPTER_E22_M1_PATH
        string "E22 M1 pin device"
        default "/dev/gpio1"
    

    config ADAPTER_E22_DRIVER
        string "E22 device uart driver path"
        default "/dev/ttyS3"

endif

if ADD_RTTHREAD_FETURES

endif
```

## APP_Framework/Framework/connection/wifi/esp8285_wifi/Kconfig
```kconfig
config ADAPTER_WIFI_ESP8285
        string "ESP8285 WIFI adapter name"
        default "esp8285_wifi"

if ADD_NUTTX_FETURES
        config ADAPTER_ESP8285_DRIVER
                string "ESP8285 device uart driver path"
                default "/dev/ttyS1"
endif
```

## APP_Framework/Framework/control/Kconfig
```kconfig
menuconfig SUPPORT_CONTROL_FRAMEWORK
    bool "support control framework"
    default n
    select TRANSFORM_LAYER_ATTRIUBUTE

if SUPPORT_CONTROL_FRAMEWORK
    source "$APP_DIR/Framework/control/ipc_protocol/Kconfig"
    source "$APP_DIR/Framework/control/plc_protocol/Kconfig"
endif
```

## Ubiquitous/Nuttx_Fusion_XiUOS/aiit_board/hc32f4a0/Kconfig
```kconfig
#
# For a description of the syntax of this configuration file,
# see the file kconfig-language.txt in the NuttX tools repository.
#

if ARCH_BOARD_HC32F4A0

config HC32F4A0_BOARD
	bool "HDSC HC32F4A0 base board"
	default n
	---help---
		Select if you are using the HC32F4A0 base board with the HC32F4A0.

endif
```

## Ubiquitous/Nuttx_Fusion_XiUOS/aiit_board/xidatong-riscv64/Kconfig
```kconfig
#
# For a description of the syntax of this configuration file,
# see misc/tools/kconfig-language.txt.
#

if ARCH_BOARD_XIDATONG_RISCV64

menuconfig BSP_USING_CH438
    bool "Using CH438 device"
    default n

if BSP_USING_CH438
config CH438_EXTUART0
    bool "Using Ch438 Port 0"
    default n

menu "Ch438 Port 0 Configuration"
    depends on CH438_EXTUART0

    config CH438_EXTUART0_BAUD
        int "Ch438 Port 0 Baud Rate."
        default 115200
        ---help---
            The configured BAUD of the CH438 EXTUART0.
endmenu

config CH438_EXTUART1
    bool "Using Ch438 Port 1"
    default n

menu "Ch438 Port 1 Configuration"
    depends on CH438_EXTUART1

    config CH438_EXTUART1_BAUD
        int "Ch438 Port 1 Baud Rate."
        default 115200
        ---help---
            The configured BAUD of the CH438 EXTUART1.
endmenu

config CH438_EXTUART2
    bool "Using Ch438 Port 2"
    default n

menu "Ch438 Port 2 Configuration"
    depends on CH438_EXTUART2

    config CH438_EXTUART2_BAUD
        int "Ch438 Port 2 Baud Rate."
        default 115200
        ---help---
            The configured BAUD of the CH438 EXTUART2.
endmenu

config CH438_EXTUART3
    bool "Using Ch438 Port 3"
    default n

menu "Ch438 Port 3 Configuration"
    depends on CH438_EXTUART3

    config CH438_EXTUART3_BAUD
        int "Ch438 Port 3 Baud Rate."
        default 115200
        ---help---
            The configured BAUD of the CH438 EXTUART3.
endmenu

config CH438_EXTUART4
    bool "Using Ch438 Port 4"
    default n

menu "Ch438 Port 4 Configuration"
    depends on CH438_EXTUART4

    config CH438_EXTUART4_BAUD
        int "Ch438 Port 4 Baud Rate."
        default 115200
        ---help---
            The configured BAUD of the CH438 EXTUART4.
endmenu

config CH438_EXTUART5
    bool "Using Ch438 Port 5"
    default n

menu "Ch438 Port 5 Configuration"
    depends on CH438_EXTUART5

    config CH438_EXTUART5_BAUD
        int "Ch438 Port 5 Baud Rate."
        default 115200
        ---help---
            The configured BAUD of the CH438 EXTUART5.
endmenu

config CH438_EXTUART6
    bool "Using Ch438 Port 6"
    default n

menu "Ch438 Port 6 Configuration"
    depends on CH438_EXTUART6

    config CH438_EXTUART6_BAUD
        int "Ch438 Port 6 Baud Rate."
        default 115200
        ---help---
            The configured BAUD of the CH438 EXTUART6.
endmenu

config CH438_EXTUART7
    bool "Using Ch438 Port 7"
    default n

menu "Ch438 Port 7 Configuration"
    depends on CH438_EXTUART7

    config CH438_EXTUART7_BAUD
        int "Ch438 Port 7 Baud Rate."
        default 115200
        ---help---
            The configured BAUD of the CH438 EXTUART7.
endmenu

endif # BSP_USING_CH438
endif # ARCH_BOARD_XIDATONG_RISCV64
```

## Ubiquitous/RT-Thread_Fusion_XiUOS/aiit_board/aiit-arm32-board/board/ports/I2c/Kconfig
```kconfig
config BSP_USING_I2C1
    bool "Enable I2C1 BUS (software simulation)"
    default y
```
